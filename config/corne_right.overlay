&i2c1 {
    compatible = "nordic,nrf-twim";
    status = "okay";
    sda-pin = <25>;
    scl-pin = <26>;
    clock-frequency = <I2C_BITRATE_FAST>;
};

&oled_display {
    compatible = "solomon,ssd1306fb";
    reg = <0x3C>;
    width = <128>;
    height = <32>;
    segment-offset = <0>;
    page-offset = <0>;
    display-offset = <0>;
    multiplex-ratio = <31>;
    i2c-dev = <&i2c1>;
};
